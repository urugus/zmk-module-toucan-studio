## dts/bindings/zmk,input-processor-toucan-pointer-speed.yaml
```yaml
description: |
  Pointer speed that the Toucan Studio app can change at runtime (A03/A05).
  Scales REL_X/REL_Y by scale/100. The value is kept in RAM until saved.

compatible: "zmk,input-processor-toucan-pointer-speed"

include: ip_zero_param.yaml

properties:
  default-scale-x100:
    type: int
    required: true
    description: Scale used when nothing is saved, as multiplier x100 (225 = 9/4).
```

## dts/bindings/zmk,input-processor-toucan-scroll.yaml
```yaml
description: |
  Per-layer trackpad scrolling that the Toucan Studio app can change at runtime (A09/A10).
  Place in the listener's base chain:
    <&node 0>, <&scroll_inertia>, <&node 1>, then the pointer speed processor.
  Stage 0 turns X/Y into wheel events (with direction) when the highest active layer
  with scrolling on asks for it; stage 1 applies that layer's speed. Layers without
  scrolling keep normal cursor movement.
  Child nodes give per-layer defaults; a layer without a child starts with scrolling off.

compatible: "zmk,input-processor-toucan-scroll"

include: ip_one_param.yaml

properties:
  inertia:
    type: phandle
    required: true
    description: The shared scroll-inertia processor.
  coast-ratio:
    type: array
    default: [5, 6]
    description: Inertia output speed relative to active scrolling, as <num den>.
  off-speed-x10000:
    type: int
    default: 2000
    description: Initial speed when scrolling is turned on for a layer without a child node.
  off-dir:
    type: int
    default: 1

child-binding:
  description: Defaults for one layer (scrolling on).
  properties:
    layer:
      type: int
      required: true
      description: Layer id.
    speed-x10000:
      type: int
      required: true
    dir:
      type: int
      default: 0
    inertia-on:
      type: boolean
    start:
      type: int
      default: 20
    decay:
      type: int
      default: 990
```

## dts/bindings/zmk,toucan-right-trackpad.yaml
```yaml
description: |
  Right-half trackpad settings adjustable from the Toucan Studio app (M6).
  Writes the Cirque Pinnacle's registers directly; the trackpad driver itself is
  used unchanged. Defaults come from the trackpad node's own properties.

compatible: "zmk,toucan-right-trackpad"

properties:
  trackpad:
    type: phandle
    required: true
    description: The `cirque,pinnacle` node (SPI).
```

## toucan-studio/Kconfig
```kconfig
DT_COMPAT_TOUCAN_POINTER_SPEED := zmk,input-processor-toucan-pointer-speed
DT_COMPAT_TOUCAN_SCROLL := zmk,input-processor-toucan-scroll
DT_COMPAT_TOUCAN_RIGHT_TRACKPAD := zmk,toucan-right-trackpad

config TOUCAN_STUDIO_POINTER_SPEED
    bool "Toucan Studio: runtime pointer speed"
    default $(dt_compat_enabled,$(DT_COMPAT_TOUCAN_POINTER_SPEED))
    select SETTINGS

config TOUCAN_STUDIO_SCROLL
    bool "Toucan Studio: runtime scroll settings"
    default $(dt_compat_enabled,$(DT_COMPAT_TOUCAN_SCROLL))
    select SETTINGS
    depends on ZMK_INPUT_PROCESSOR_SCROLL_INERTIA

config TOUCAN_STUDIO_RAW_HID
    bool "Toucan Studio: settings protocol over raw HID (A03/A06/A14)"
    default y
    depends on RAW_HID && (TOUCAN_STUDIO_POINTER_SPEED || TOUCAN_STUDIO_SCROLL)

# Right half (peripheral): trackpad settings, answered over the left half's link service.
config TOUCAN_STUDIO_RIGHT_TRACKPAD
    bool "Toucan Studio: right-half trackpad settings (M6)"
    default $(dt_compat_enabled,$(DT_COMPAT_TOUCAN_RIGHT_TRACKPAD))
    depends on SPI && BT
    select SETTINGS
    select BT_GATT_CLIENT

# Left half (central): relays right-half requests from the app over the split link.
config TOUCAN_STUDIO_RIGHT_RELAY
    bool "Toucan Studio: relay right-half settings (M6)"
    default y
    depends on TOUCAN_STUDIO_RAW_HID && ZMK_SPLIT_ROLE_CENTRAL && ZMK_SPLIT_BLE
```
